## sources/meta-advantech/conf/layer.conf
```bitbake
# We have a conf and classes directory, add to BBPATH
BBPATH .= ":${LAYERDIR}"

# We have recipes-* directories, add to BBFILES
BBFILES += "${LAYERDIR}/recipes-*/*/*.bb \
	${LAYERDIR}/recipes-*/*/*.bbappend"

BBFILE_COLLECTIONS += "advantech"
BBFILE_PATTERN_advantech = "^${LAYERDIR}/"
BBFILE_PRIORITY_advantech = "6"

## this is needed for linux and uboot imx recipes
PREFERRED_VERSION_u-boot-imx_mx6 = "2013.04"

# Alljoyn npm package requires node v0.10.35 or higher in the 0.10 series
PREFERRED_VERSION_nodejs = "0.10.35"
```

## sources/meta-advantech/conf/machine/imx6dlubc220.conf
```bitbake
#@TYPE: Machine
#@NAME: Freescale i.MX6DL SABRE Smart Device
#@SOC: i.MX6DL
#@DESCRIPTION: Machine configuration for Freescale i.MX6DL SABRE Smart Device

require conf/machine/include/imx6sabresd-common.inc
require conf/machine/include/advantech-default-settings.inc

SOC_FAMILY = "mx6:mx6dl"

KERNEL_DEVICETREE = "imx6dl-ubc220.dtb"

UBOOT_CONFIG ??= "sd"
UBOOT_CONFIG[sd] = "mx6dlubc220_1G_config,sdcard"

# build all vpu firmware packages into the image
MACHINE_FIRMWARE_append_mx6 = " firmware-imx-vpu-imx6q firmware-imx-vpu-imx6d"
```
